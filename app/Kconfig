## app/Kconfig
```kconfig
menu "Zephyr"
source "Kconfig.zephyr"
endmenu

module = ZEPHYR-SMALL-DOG
module-str = Zephyr Small Dog
source "subsys/logging/Kconfig.template.log_config"
```

## boards/xtensa/nodemcu_esp_32s_kit/Kconfig.board
```kconfig
# Copyright (c) 2022 Tobias Piep
# SPDX-License-Identifier: Apache-2.0

config BOARD_NODEMCU_ESP_32S_KIT
	bool "NodeMCU ESP32S Kit"
	depends on SOC_ESP32
```

## boards/xtensa/nodemcu_esp_32s_kit/Kconfig.defconfig
```kconfig
# Copyright (c) 2022 Tobias Piep
# SPDX-License-Identifier: Apache-2.0

if BOARD_NODEMCU_ESP_32S_KIT

config BOARD
	default "nodemcu_esp_32s_kit"

endif # BOARD_NODEMCU_ESP_32S_KIT
```

## west.yml
```yaml
manifest:
  self:
    path: zephyr-small-dog

  remotes:
    - name: zephyrproject-rtos
      url-base: https://github.com/zephyrproject-rtos

  projects:
    - name: zephyr
      remote: zephyrproject-rtos
      revision: main
      import: true
```
